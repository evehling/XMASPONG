

//screen = 64x128 pixels
#include <Arduboy.h>
Arduboy ad;

#define WIDTH 128
#define HEIGHT 62

const unsigned char image[] PROGMEM = {
  0x00, 0x00, 0x00, 0x00, 0x00, 0x00, 0x00, 0x00, 
  0x00, 0x00, 0x00, 0x00, 0x00, 0x00, 0x00, 0x00, 
  0x00, 0x00, 0x00, 0x00, 0x00, 0x00, 0x00, 0x00, 
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  0x00, 0x00, 0x00, 0x00, 0x00, 0x00, 0x00, 0x00, 
  
};

const unsigned char image2[] PROGMEM = {
  0x00, 0x00, 0x00, 0x00, 0x00, 0x00, 0x00, 0x00, 
  0x00, 0xe0, 0xe0, 0xe0, 0xe0, 0xe0, 0xe0, 0x80, 
  0x80, 0x80, 0x00, 0x00, 0xc0, 0xe0, 0xe0, 0xe0, 
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  0x00, 0x00, 0x00, 0x00, 0x00, 0x00, 0x00, 0x00, 
  
};
const unsigned char image3[] PROGMEM = {
  0x00, 0x00, 0x00, 0x00, 0x00, 0x00, 0x00, 0x00, 
  0x00, 0x00, 0x00, 0x00, 0x00, 0x00, 0x00, 0x00, 
  0x00, 0x00, 0x00, 0x00, 0x00, 0x00, 0x00, 0x00, 
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  0x00, 0x00, 0x00, 0x00, 0x00, 0x00, 0x00, 0x00, 
  
};
const unsigned char image4[] PROGMEM = {
  0x00, 0x00, 0x00, 0x00, 0x00, 0x00, 0x00, 0x00, 
  0x00, 0x80, 0x80, 0x80, 0xa0, 0xf0, 0xf0, 0xf0, 
  0xf0, 0xf0, 0xf0, 0xf0, 0xf0, 0xf0, 0xf0, 0xf0, 
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  0x00, 0x00, 0x00, 0x00, 0x00, 0x00, 0x00, 0x00, 
  
};

int gs = 0;
int jp = 0;

//ball's location:
int bx = 62;
int by = 0;
int bs = 4;

//ball direction
int br = -1;
int bd = 1;

//paddle
int pw = 4;
int ph = 9;
int px=0;
int py = 0;

//computer paddle
int cpy = 0;
int cpx = 127-pw;
int ps = 0;
int cs = 0;

int counter = 0;

void resetgame(){
  bx=63;
  ps=0;
  cs=0;
}

void setup() {
  ad.begin();
  srand(7/8);
  ad.setFrameRate(60);
  ad.clear();
  
}

void loop() {
  if(!ad.nextFrame()){
    return;
  }
  ad.clear();
  switch(gs){
    case 0:
      ad.drawBitmap(0,0,image2,WIDTH,HEIGHT,1);
      if(ad.pressed(A_BUTTON) and jp == 0){
        jp = 1;
        gs =1;
      }
      break;
    case 1:
      //title screen
      ad.drawBitmap(0,-5, image, WIDTH,HEIGHT,1);
      ad.setCursor(10,55);
      ad.print("PRESS   TO CONTINUE");
      counter +=1;
      if(counter <60){
        ad.setCursor(46,55);
        ad.print("A");
      }
      if(counter >= 120){
        counter=0;
      }
      if(ad.pressed(A_BUTTON) and jp == 0){
        jp = 1;
        gs =2;
      }
      break;
    case 2:
      //gameplay screen
      ad.setCursor(0,0);
      ad.print("TIM:");
      ad.setCursor(25,0);
      ad.print(ps);
      ad.setCursor(90,0);
      ad.print("CPU:");
      ad.setCursor(118,0);
      ad.print(cs);
      ad.fillRect(bx, by,bs,bs, WHITE);
      if(br==1){
        bx+=1;
      }
      if(br==-1){
        bx -=1;
      }
      if(bd == 1){
        by += 1;
      }
      if(bd ==-1){
        by -=1;
      }
      if(by==0){
        bd=1;
      }
      if(by+bs ==63){
        bd = -1;
      }
      ad.fillRect(px,py,pw,ph,WHITE);
      if(ad.pressed(UP_BUTTON) and py >0){
        py -=1;
      }
      if(ad.pressed(DOWN_BUTTON) and py+ph <63){
        py +=1;
      }
      ad.fillRect(cpx,cpy,pw,ph,WHITE);
      if(bx >115 or rand()%20==1){
        if(by<cpy){
          cpy -=1;
        }
        if(by +bs>cpy+ph){
          cpy +=1;
        }
      }
      if(bx < -10){
        bx=63;
        cs +=1;
      }
      if(bx>130){
        bx = 63;
        ps +=1;
      }
      if(ps==5){
        gs = 3;
      }
      if(cs==5){
        gs=4;
      }
      if(bx ==px +pw and py<by+bs and py+ph >by){
        br =1;
      }
      if(bx +bs ==cpx and cpy <by+bs and cpy+ph>by){
        br=-1;
      }
      break;

 //----------------------------
    case 3:
      //win screen
      ad.drawBitmap(0,0,image3,WIDTH,HEIGHT,1);
      if(ad.pressed(A_BUTTON) and jp ==0){
        jp =1;
        resetgame();
        gs=1;
      }
      break;
    case 4:
      //game over screen
      ad.drawBitmap(0,0,image4,WIDTH,HEIGHT,1);
      if(ad.pressed(A_BUTTON) and jp == 0){
        jp = 1;
        resetgame();
        gs=1;
      }
      break;
  }
  if(ad.notPressed(A_BUTTON)){
    jp = 0;
  }
  ad.display();
}
